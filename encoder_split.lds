/* Linker script for the decompressor prefix cut.
 *
 * The submitted binary is a self-extracting archive: a small stub unpacks the
 * compressor image into memory and runs it.  Only the DECOMPRESSOR half has
 * to be present in the shipped archive, so every function that only the
 * compressor can reach is collected in one section, .encoder_only, which is
 * placed behind the decompressor prefix.  Those bytes are then counted once
 * instead of twice.
 *
 * Each symbol is listed with all three possible prefixes (.text.,
 * .text.unlikely., .text.hot.).  Which one a function ends up in is decided by
 * the PGO profile; the symbol SET does not depend on the profile, only its
 * classification does.  Patterns that do not match are harmless to the linker.
 *
 * The build verifies the result: tools_src/packer/cut_dpath.py walks the
 * call graph from the decompressor entry point and aborts the build if any
 * function placed in .encoder_only is reachable from it.  A wrong entry here
 * would compress fine and crash only during verification. */
SECTIONS
{
  .encoder_only : {
    
    *(.text._ZNSt6vectorImSaImEE17_M_realloc_insertIJRKmEEEvN9__gnu_cxx17__normal_iteratorIPmS1_EEDpOT_ .text.unlikely._ZNSt6vectorImSaImEE17_M_realloc_insertIJRKmEEEvN9__gnu_cxx17__normal_iteratorIPmS1_EEDpOT_ .text.hot._ZNSt6vectorImSaImEE17_M_realloc_insertIJRKmEEEvN9__gnu_cxx17__normal_iteratorIPmS1_EEDpOT_)
    *(.text._ZNSt6vectorIPN12census_block8VarianteESaIS2_EEaSERKS4_ .text.unlikely._ZNSt6vectorIPN12census_block8VarianteESaIS2_EEaSERKS4_ .text.hot._ZNSt6vectorIPN12census_block8VarianteESaIS2_EEaSERKS4_)
    *(.text._ZNSt6vectorIPN12census_block7FamilieESaIS2_EEaSERKS4_ .text.unlikely._ZNSt6vectorIPN12census_block7FamilieESaIS2_EEaSERKS4_ .text.hot._ZNSt6vectorIPN12census_block7FamilieESaIS2_EEaSERKS4_)
    *(.text._ZNSt6vectorINSt7__cxx1112basic_stringIcSt11char_traitsIcESaIcEEESaIS5_EEaSERKS7_ .text.unlikely._ZNSt6vectorINSt7__cxx1112basic_stringIcSt11char_traitsIcESaIcEEESaIS5_EEaSERKS7_ .text.hot._ZNSt6vectorINSt7__cxx1112basic_stringIcSt11char_traitsIcESaIcEEESaIS5_EEaSERKS7_)
    *(.text._ZNSt6vectorINSt7__cxx1112basic_stringIcSt11char_traitsIcESaIcEEESaIS5_EE20_M_allocate_and_copyIN9__gnu_cxx17__normal_iteratorIPKS5_S7_EEEEPS5_mT_SF_ .text.unlikely._ZNSt6vectorINSt7__cxx1112basic_stringIcSt11char_traitsIcESaIcEEESaIS5_EE20_M_allocate_and_copyIN9__gnu_cxx17__normal_iteratorIPKS5_S7_EEEEPS5_mT_SF_ .text.hot._ZNSt6vectorINSt7__cxx1112basic_stringIcSt11char_traitsIcESaIcEEESaIS5_EE20_M_allocate_and_copyIN9__gnu_cxx17__normal_iteratorIPKS5_S7_EEEEPS5_mT_SF_)
    *(.text._ZNSt6vectorIhSaIhEE19_M_range_initializeIN9__gnu_cxx17__normal_iteratorIPcS_IcSaIcEEEEEEvT_S9_St20forward_iterator_tag .text.unlikely._ZNSt6vectorIhSaIhEE19_M_range_initializeIN9__gnu_cxx17__normal_iteratorIPcS_IcSaIcEEEEEEvT_S9_St20forward_iterator_tag .text.hot._ZNSt6vectorIhSaIhEE19_M_range_initializeIN9__gnu_cxx17__normal_iteratorIPcS_IcSaIcEEEEEEvT_S9_St20forward_iterator_tag)
    *(.text._ZNSt6vectorIcSaIcEE12emplace_backIJcEEERcDpOT_ .text.unlikely._ZNSt6vectorIcSaIcEE12emplace_backIJcEEERcDpOT_ .text.hot._ZNSt6vectorIcSaIcEE12emplace_backIJcEEERcDpOT_)
    *(.text._ZNSt6vectorImSaImEE9push_backERKm .text.unlikely._ZNSt6vectorImSaImEE9push_backERKm .text.hot._ZNSt6vectorImSaImEE9push_backERKm)
    *(.text._ZZN12census_block4zahl3Run7StetigKERKNS0_9StetigKodEENKUldRKNSt7__cxx1112basic_stringIcSt11char_traitsIcESaIcEEEPdE_clEdSC_SD_ .text.unlikely._ZZN12census_block4zahl3Run7StetigKERKNS0_9StetigKodEENKUldRKNSt7__cxx1112basic_stringIcSt11char_traitsIcESaIcEEEPdE_clEdSC_SD_ .text.hot._ZZN12census_block4zahl3Run7StetigKERKNS0_9StetigKodEENKUldRKNSt7__cxx1112basic_stringIcSt11char_traitsIcESaIcEEEPdE_clEdSC_SD_)
    *(.text._ZNSt4pairINSt7__cxx1112basic_stringIcSt11char_traitsIcESaIcEEElEC2IS5_RlTnNSt9enable_ifIXaaclsr5_PCCPE22_MoveConstructiblePairIT_T0_EEclsr5_PCCPE30_ImplicitlyMoveConvertiblePairISA_SB_EEEbE4typeELb1EEEOSA_OSB_ .text.unlikely._ZNSt4pairINSt7__cxx1112basic_stringIcSt11char_traitsIcESaIcEEElEC2IS5_RlTnNSt9enable_ifIXaaclsr5_PCCPE22_MoveConstructiblePairIT_T0_EEclsr5_PCCPE30_ImplicitlyMoveConvertiblePairISA_SB_EEEbE4typeELb1EEEOSA_OSB_ .text.hot._ZNSt4pairINSt7__cxx1112basic_stringIcSt11char_traitsIcESaIcEEElEC2IS5_RlTnNSt9enable_ifIXaaclsr5_PCCPE22_MoveConstructiblePairIT_T0_EEclsr5_PCCPE30_ImplicitlyMoveConvertiblePairISA_SB_EEEbE4typeELb1EEEOSA_OSB_)
    *(.text._ZN12census_block4zahl9NachkommaERKNSt7__cxx1112basic_stringIcSt11char_traitsIcESaIcEEE .text.unlikely._ZN12census_block4zahl9NachkommaERKNSt7__cxx1112basic_stringIcSt11char_traitsIcESaIcEEE .text.hot._ZN12census_block4zahl9NachkommaERKNSt7__cxx1112basic_stringIcSt11char_traitsIcESaIcEEE)
    *(.text._ZNSt11__copy_moveILb0ELb0ESt26random_access_iterator_tagE8__copy_mIPKNSt7__cxx1112basic_stringIcSt11char_traitsIcESaIcEEEPS8_EET0_T_SD_SC_ .text.unlikely._ZNSt11__copy_moveILb0ELb0ESt26random_access_iterator_tagE8__copy_mIPKNSt7__cxx1112basic_stringIcSt11char_traitsIcESaIcEEEPS8_EET0_T_SD_SC_ .text.hot._ZNSt11__copy_moveILb0ELb0ESt26random_access_iterator_tagE8__copy_mIPKNSt7__cxx1112basic_stringIcSt11char_traitsIcESaIcEEEPS8_EET0_T_SD_SC_)
    *(.text._ZNSt11__copy_moveILb0ELb0ESt26random_access_iterator_tagE8__copy_mIPNSt7__cxx1112basic_stringIcSt11char_traitsIcESaIcEEES9_EET0_T_SB_SA_ .text.unlikely._ZNSt11__copy_moveILb0ELb0ESt26random_access_iterator_tagE8__copy_mIPNSt7__cxx1112basic_stringIcSt11char_traitsIcESaIcEEES9_EET0_T_SB_SA_ .text.hot._ZNSt11__copy_moveILb0ELb0ESt26random_access_iterator_tagE8__copy_mIPNSt7__cxx1112basic_stringIcSt11char_traitsIcESaIcEEES9_EET0_T_SB_SA_)
    *(.text._ZSt16__do_uninit_copyIN9__gnu_cxx17__normal_iteratorIPKNSt7__cxx1112basic_stringIcSt11char_traitsIcESaIcEEESt6vectorIS7_SaIS7_EEEEPS7_ET0_T_SG_SF_ .text.unlikely._ZSt16__do_uninit_copyIN9__gnu_cxx17__normal_iteratorIPKNSt7__cxx1112basic_stringIcSt11char_traitsIcESaIcEEESt6vectorIS7_SaIS7_EEEEPS7_ET0_T_SG_SF_ .text.hot._ZSt16__do_uninit_copyIN9__gnu_cxx17__normal_iteratorIPKNSt7__cxx1112basic_stringIcSt11char_traitsIcESaIcEEESt6vectorIS7_SaIS7_EEEEPS7_ET0_T_SG_SF_)
    *(.text._ZSt16__do_uninit_copyIPNSt7__cxx1112basic_stringIcSt11char_traitsIcESaIcEEES6_ET0_T_S8_S7_ .text.unlikely._ZSt16__do_uninit_copyIPNSt7__cxx1112basic_stringIcSt11char_traitsIcESaIcEEES6_ET0_T_S8_S7_ .text.hot._ZSt16__do_uninit_copyIPNSt7__cxx1112basic_stringIcSt11char_traitsIcESaIcEEES6_ET0_T_S8_S7_)
    *(.text._ZNKSt8_Rb_treeINSt7__cxx1112basic_stringIcSt11char_traitsIcESaIcEEESt4pairIKS5_N12census_block7FamilieEESt10_Select1stISA_ESt4lessIS5_ESaISA_EE14_M_lower_boundEPKSt13_Rb_tree_nodeISA_EPKSt18_Rb_tree_node_baseRS7_ .text.unlikely._ZNKSt8_Rb_treeINSt7__cxx1112basic_stringIcSt11char_traitsIcESaIcEEESt4pairIKS5_N12census_block7FamilieEESt10_Select1stISA_ESt4lessIS5_ESaISA_EE14_M_lower_boundEPKSt13_Rb_tree_nodeISA_EPKSt18_Rb_tree_node_baseRS7_ .text.hot._ZNKSt8_Rb_treeINSt7__cxx1112basic_stringIcSt11char_traitsIcESaIcEEESt4pairIKS5_N12census_block7FamilieEESt10_Select1stISA_ESt4lessIS5_ESaISA_EE14_M_lower_boundEPKSt13_Rb_tree_nodeISA_EPKSt18_Rb_tree_node_baseRS7_)
    *(.text._ZNSt11__copy_moveILb0ELb0ESt26random_access_iterator_tagE8__copy_mIPcPhEET0_T_S6_S5_ .text.unlikely._ZNSt11__copy_moveILb0ELb0ESt26random_access_iterator_tagE8__copy_mIPcPhEET0_T_S6_S5_ .text.hot._ZNSt11__copy_moveILb0ELb0ESt26random_access_iterator_tagE8__copy_mIPcPhEET0_T_S6_S5_)
    *(.text._ZStplIcSt11char_traitsIcESaIcEENSt7__cxx1112basic_stringIT_T0_T1_EERKS8_OS8_ .text.unlikely._ZStplIcSt11char_traitsIcESaIcEENSt7__cxx1112basic_stringIT_T0_T1_EERKS8_OS8_ .text.hot._ZStplIcSt11char_traitsIcESaIcEENSt7__cxx1112basic_stringIT_T0_T1_EERKS8_OS8_)
    *(.text._ZSt13__copy_move_aILb0EN9__gnu_cxx17__normal_iteratorIPKNSt7__cxx1112basic_stringIcSt11char_traitsIcESaIcEEESt6vectorIS7_SaIS7_EEEENS1_IPS7_SC_EEET1_T0_SH_SG_ .text.unlikely._ZSt13__copy_move_aILb0EN9__gnu_cxx17__normal_iteratorIPKNSt7__cxx1112basic_stringIcSt11char_traitsIcESaIcEEESt6vectorIS7_SaIS7_EEEENS1_IPS7_SC_EEET1_T0_SH_SG_ .text.hot._ZSt13__copy_move_aILb0EN9__gnu_cxx17__normal_iteratorIPKNSt7__cxx1112basic_stringIcSt11char_traitsIcESaIcEEESt6vectorIS7_SaIS7_EEEENS1_IPS7_SC_EEET1_T0_SH_SG_)
    *(.text._ZN12preprocessor10Dictionary6EncodeEP8_IO_FILEiS2_ .text.unlikely._ZN12preprocessor10Dictionary6EncodeEP8_IO_FILEiS2_ .text.hot._ZN12preprocessor10Dictionary6EncodeEP8_IO_FILEiS2_)
    *(.text._ZN12preprocessor10Dictionary10EncodeWordERKNSt7__cxx1112basic_stringIcSt11char_traitsIcESaIcEEEibP8_IO_FILE .text.unlikely._ZN12preprocessor10Dictionary10EncodeWordERKNSt7__cxx1112basic_stringIcSt11char_traitsIcESaIcEEEibP8_IO_FILE .text.hot._ZN12preprocessor10Dictionary10EncodeWordERKNSt7__cxx1112basic_stringIcSt11char_traitsIcESaIcEEEibP8_IO_FILE)
    *(.text._ZN12preprocessor12_GLOBAL__N_111EncodeBytesEjP8_IO_FILE .text.unlikely._ZN12preprocessor12_GLOBAL__N_111EncodeBytesEjP8_IO_FILE .text.hot._ZN12preprocessor12_GLOBAL__N_111EncodeBytesEjP8_IO_FILE)
    *(.text._ZN12preprocessor10Dictionary15EncodeSubstringERKNSt7__cxx1112basic_stringIcSt11char_traitsIcESaIcEEEP8_IO_FILE .text.unlikely._ZN12preprocessor10Dictionary15EncodeSubstringERKNSt7__cxx1112basic_stringIcSt11char_traitsIcESaIcEEEP8_IO_FILE .text.hot._ZN12preprocessor10Dictionary15EncodeSubstringERKNSt7__cxx1112basic_stringIcSt11char_traitsIcESaIcEEEP8_IO_FILE)
    *(.text._ZN10r1_reorder22ReorderEncodedTailFileERKNSt7__cxx1112basic_stringIcSt11char_traitsIcESaIcEEES7_ .text.unlikely._ZN10r1_reorder22ReorderEncodedTailFileERKNSt7__cxx1112basic_stringIcSt11char_traitsIcESaIcEEES7_ .text.hot._ZN10r1_reorder22ReorderEncodedTailFileERKNSt7__cxx1112basic_stringIcSt11char_traitsIcESaIcEEES7_)
    *(.text._Z11WriteHeaderyRKSt6vectorIbSaIbEEbPSt14basic_ofstreamIcSt11char_traitsIcEE .text.unlikely._Z11WriteHeaderyRKSt6vectorIbSaIbEEbPSt14basic_ofstreamIcSt11char_traitsIcEE .text.hot._Z11WriteHeaderyRKSt6vectorIbSaIbEEbPSt14basic_ofstreamIcSt11char_traitsIcEE)
    *(.text._Z14RunCompressionbRKNSt7__cxx1112basic_stringIcSt11char_traitsIcESaIcEEES6_S6_P8_IO_FILEPyS9_PKc .text.unlikely._Z14RunCompressionbRKNSt7__cxx1112basic_stringIcSt11char_traitsIcESaIcEEES6_S6_P8_IO_FILEPyS9_PKc .text.hot._Z14RunCompressionbRKNSt7__cxx1112basic_stringIcSt11char_traitsIcESaIcEEES6_S6_P8_IO_FILEPyS9_PKc)
    *(.text._ZN12preprocessor12NoPreprocessEP8_IO_FILES1_y .text.unlikely._ZN12preprocessor12NoPreprocessEP8_IO_FILES1_y .text.hot._ZN12preprocessor12NoPreprocessEP8_IO_FILES1_y)
    *(.text._Z12ExtractVocabyPSt14basic_ifstreamIcSt11char_traitsIcEEPSt6vectorIbSaIbEE .text.unlikely._Z12ExtractVocabyPSt14basic_ifstreamIcSt11char_traitsIcEEPSt6vectorIbSaIbEE .text.hot._Z12ExtractVocabyPSt14basic_ifstreamIcSt11char_traitsIcEEPSt6vectorIbSaIbEE)
    *(.text._Z8CompressyP8_IO_FILES0_PyP9Predictor .text.unlikely._Z8CompressyP8_IO_FILES0_PyP9Predictor .text.hot._Z8CompressyP8_IO_FILES0_PyP9Predictor)
    *(.text._ZNSt6vectorIdSaIdEEC2EmRKS0_ .text.unlikely._ZNSt6vectorIdSaIdEEC2EmRKS0_ .text.hot._ZNSt6vectorIdSaIdEEC2EmRKS0_)
    *(.text._ZN12preprocessor6EncodeEP8_IO_FILES1_yS1_ .text.unlikely._ZN12preprocessor6EncodeEP8_IO_FILES1_yS1_ .text.hot._ZN12preprocessor6EncodeEP8_IO_FILES1_yS1_)
    *(.text._ZN12preprocessor13EncodeSegmentEP8_IO_FILES1_iS1_Pd .text.unlikely._ZN12preprocessor13EncodeSegmentEP8_IO_FILES1_iS1_Pd .text.hot._ZN12preprocessor13EncodeSegmentEP8_IO_FILES1_iS1_Pd)
    *(.text._ZN12preprocessor6detectEP8_IO_FILEiNS_8FiletypeE .text.unlikely._ZN12preprocessor6detectEP8_IO_FILEiNS_8FiletypeE .text.hot._ZN12preprocessor6detectEP8_IO_FILEiNS_8FiletypeE)
    *(.text._ZN12preprocessor11encode_textEP8_IO_FILES1_iS1_ .text.unlikely._ZN12preprocessor11encode_textEP8_IO_FILES1_iS1_ .text.hot._ZN12preprocessor11encode_textEP8_IO_FILES1_iS1_)
    *(.text._ZNSt6thread11_State_implINS_8_InvokerISt5tupleIJPFvvEEEEEE6_M_runEv .text.unlikely._ZNSt6thread11_State_implINS_8_InvokerISt5tupleIJPFvvEEEEEE6_M_runEv .text.hot._ZNSt6thread11_State_implINS_8_InvokerISt5tupleIJPFvvEEEEEE6_M_runEv)
    *(.text._ZNSt11unique_lockISt5mutexE4lockEv .text.unlikely._ZNSt11unique_lockISt5mutexE4lockEv .text.hot._ZNSt11unique_lockISt5mutexE4lockEv)
    *(.text._ZNSt6threadC2IRFvvEJEvEEOT_DpOT0_ .text.unlikely._ZNSt6threadC2IRFvvEJEvEEOT_DpOT0_ .text.hot._ZNSt6threadC2IRFvvEJEvEEOT_DpOT0_)
    *(.text._ZN10r1_reorder12_GLOBAL__N_113Fast2CmpBlockEPKvS2_Pv .text.unlikely._ZN10r1_reorder12_GLOBAL__N_113Fast2CmpBlockEPKvS2_Pv .text.hot._ZN10r1_reorder12_GLOBAL__N_113Fast2CmpBlockEPKvS2_Pv)
    *(.text._ZN10r1_reorder12_GLOBAL__N_112AppendVarintEPNS0_7ByteBufEm .text.unlikely._ZN10r1_reorder12_GLOBAL__N_112AppendVarintEPNS0_7ByteBufEm .text.hot._ZN10r1_reorder12_GLOBAL__N_112AppendVarintEPNS0_7ByteBufEm)
    *(.text._Z7reorderv .text.unlikely._Z7reorderv .text.hot._Z7reorderv)
    *(.text._Z4readPKcR10HeaderInfo .text.unlikely._Z4readPKcR10HeaderInfo .text.hot._Z4readPKcR10HeaderInfo)
    *(.text._Z16selfextract_compv .text.unlikely._Z16selfextract_compv .text.hot._Z16selfextract_compv)
    
    *(.text._ZZ4mainENK3?_0clEv .text.unlikely._ZZ4mainENK3?_0clEv .text.hot._ZZ4mainENK3?_0clEv)
    *(.text._Z8wctoutf8Pcj .text.unlikely._Z8wctoutf8Pcj .text.hot._Z8wctoutf8Pcj)
    *(.text._Z4hentPcS_ .text.unlikely._Z4hentPcS_ .text.hot._Z4hentPcS_)
    *(.text._Z5hent2PcS_ .text.unlikely._Z5hent2PcS_ .text.hot._Z5hent2PcS_)
    *(.text._Z5hent5PcS_ .text.unlikely._Z5hent5PcS_ .text.hot._Z5hent5PcS_)
    *(.text._Z8henttailPcS_P8_IO_FILE .text.unlikely._Z8henttailPcS_P8_IO_FILE .text.hot._Z8henttailPcS_P8_IO_FILE)
    *(.text._Z14encode_txt_witP8_IO_FILES0_ .text.unlikely._Z14encode_txt_witP8_IO_FILES0_ .text.hot._Z14encode_txt_witP8_IO_FILES0_)
    *(.text._Z11phda9_preprv .text.unlikely._Z11phda9_preprv .text.hot._Z11phda9_preprv)
    *(.text._Z10split4CompPKc .text.unlikely._Z10split4CompPKc .text.hot._Z10split4CompPKc)
    *(.text._Z11getFileSizePKc .text.unlikely._Z11getFileSizePKc .text.hot._Z11getFileSizePKc)
    *(.text._ZN3ord9Extractor4LineEPKcmPNS_8PageScanE .text.unlikely._ZN3ord9Extractor4LineEPKcmPNS_8PageScanE .text.hot._ZN3ord9Extractor4LineEPKcmPNS_8PageScanE)
    
    *(.text._ZN3ord9Extractor4PushEm .text.unlikely._ZN3ord9Extractor4PushEm .text.hot._ZN3ord9Extractor4PushEm)
    *(.text._ZN3ordL11IsRedirLineEPKcm .text.unlikely._ZN3ordL11IsRedirLineEPKcm .text.hot._ZN3ordL11IsRedirLineEPKcm)
    *(.text._ZN3ordL5Fnv1aEhPKcm .text.unlikely._ZN3ordL5Fnv1aEhPKcm .text.hot._ZN3ordL5Fnv1aEhPKcm)
    *(.text._ZN3ordL9StripSpanERPKcS2_ .text.unlikely._ZN3ordL9StripSpanERPKcS2_ .text.hot._ZN3ordL9StripSpanERPKcS2_)
    *(.text._ZN3ordL6KalNumEPKcmPl .text.unlikely._ZN3ordL6KalNumEPKcmPl .text.hot._ZN3ordL6KalNumEPKcmPl)
    *(.text._ZNSt6vectorIS_IiSaIiEESaIS1_EEC2EmRKS2_ .text.unlikely._ZNSt6vectorIS_IiSaIiEESaIS1_EEC2EmRKS2_ .text.hot._ZNSt6vectorIS_IiSaIiEESaIS1_EEC2EmRKS2_)
    *(.text._ZN3ord9ORDV3Vote4InitEiPKi .text.unlikely._ZN3ord9ORDV3Vote4InitEiPKi .text.hot._ZN3ord9ORDV3Vote4InitEiPKi)
    *(.text._ZN3ord9ORDV3Vote5ScoreEiPKmmPKiPKjPKlS4_i .text.unlikely._ZN3ord9ORDV3Vote5ScoreEiPKmmPKiPKjPKlS4_i .text.hot._ZN3ord9ORDV3Vote5ScoreEiPKmmPKiPKjPKlS4_i)
    
    *(.text._ZNSt6vectorIiSaIiEE17_M_realloc_insertIJiEEEvN9__gnu_cxx17__normal_iteratorIPiS1_EEDpOT_ .text.unlikely._ZNSt6vectorIiSaIiEE17_M_realloc_insertIJiEEEvN9__gnu_cxx17__normal_iteratorIPiS1_EEDpOT_ .text.hot._ZNSt6vectorIiSaIiEE17_M_realloc_insertIJiEEEvN9__gnu_cxx17__normal_iteratorIPiS1_EEDpOT_)
    *(.text._ZN3ord9Extractor5TitleEPKcS2_ .text.unlikely._ZN3ord9Extractor5TitleEPKcS2_ .text.hot._ZN3ord9Extractor5TitleEPKcS2_)
    *(.text._ZN3ord9Extractor9FlagsLineEPKcm .text.unlikely._ZN3ord9Extractor9FlagsLineEPKcm .text.hot._ZN3ord9Extractor9FlagsLineEPKcm)
    *(.text._ZN3ord9Extractor8LeadLineEPKcm .text.unlikely._ZN3ord9Extractor8LeadLineEPKcm .text.hot._ZN3ord9Extractor8LeadLineEPKcm)
    *(.text._ZN3ord9Extractor9FeatsLineEPKcm .text.unlikely._ZN3ord9Extractor9FeatsLineEPKcm .text.hot._ZN3ord9Extractor9FeatsLineEPKcm)
    *(.text._ZN3ordL6IlnQ57Em .text.unlikely._ZN3ordL6IlnQ57Em .text.hot._ZN3ordL6IlnQ57Em)
    *(.text._ZNSt6vectorIlSaIlEE14_M_fill_assignEmRKl .text.unlikely._ZNSt6vectorIlSaIlEE14_M_fill_assignEmRKl .text.hot._ZNSt6vectorIlSaIlEE14_M_fill_assignEmRKl)
    *(.text._ZNSt6vectorIlSaIlEEC2EmRKlRKS0_ .text.unlikely._ZNSt6vectorIlSaIlEEC2EmRKlRKS0_ .text.hot._ZNSt6vectorIlSaIlEEC2EmRKlRKS0_)
    *(.text._ZNSt6thread11_State_implINS_8_InvokerISt5tupleIJPFvvEEEEEED0Ev .text.unlikely._ZNSt6thread11_State_implINS_8_InvokerISt5tupleIJPFvvEEEEEED0Ev .text.hot._ZNSt6thread11_State_implINS_8_InvokerISt5tupleIJPFvvEEEEEED0Ev)
    
    *dict_derive.o(.text._Z* .text.unlikely.* .text.hot.* .text.enc_only .rodata._Z* .rodata.cst*)
    *(.text._ZN7EncoderC1EP8_IO_FILEP9Predictor .text.unlikely._ZN7EncoderC1EP8_IO_FILEP9Predictor .text.hot._ZN7EncoderC1EP8_IO_FILEP9Predictor)
    *(.text._ZN7EncoderC2EP8_IO_FILEP9Predictor .text.unlikely._ZN7EncoderC2EP8_IO_FILEP9Predictor .text.hot._ZN7EncoderC2EP8_IO_FILEP9Predictor)
    *(.text._ZN7Encoder6EncodeEi .text.unlikely._ZN7Encoder6EncodeEi .text.hot._ZN7Encoder6EncodeEi)
    *(.text._ZN7Encoder5FlushEv .text.unlikely._ZN7Encoder5FlushEv .text.hot._ZN7Encoder5FlushEv)
    
    *(.text._Z5StoreRKNSt7__cxx1112basic_stringIcSt11char_traitsIcESaIcEEES6_S6_P8_IO_FILEPyS9_ .text.unlikely._Z5StoreRKNSt7__cxx1112basic_stringIcSt11char_traitsIcESaIcEEES6_S6_P8_IO_FILEPyS9_ .text.hot._Z5StoreRKNSt7__cxx1112basic_stringIcSt11char_traitsIcESaIcEEES6_S6_P8_IO_FILEPyS9_)
    *(.text._ZN7Encoder9WriteByteEj .text.unlikely._ZN7Encoder9WriteByteEj .text.hot._ZN7Encoder9WriteByteEj)
    *(.text._Z17WriteHeaderVocfixybP8_IO_FILE .text.unlikely._Z17WriteHeaderVocfixybP8_IO_FILE .text.hot._Z17WriteHeaderVocfixybP8_IO_FILE)
    *(.text._ZN12vocab_frozen9PutHeaderEP8_IO_FILEij .text.unlikely._ZN12vocab_frozen9PutHeaderEP8_IO_FILEij .text.hot._ZN12vocab_frozen9PutHeaderEP8_IO_FILEij)
    *(.text._ZNK12preprocessor11FastWordMap4FindEPKcjPj .text.unlikely._ZNK12preprocessor11FastWordMap4FindEPKcjPj .text.hot._ZNK12preprocessor11FastWordMap4FindEPKcjPj)

    
    *(.text._ZN14metablock_form4PackERKNSt7__cxx1112basic_stringIcSt11char_traitsIcESaIcEEE .text.unlikely._ZN14metablock_form4PackERKNSt7__cxx1112basic_stringIcSt11char_traitsIcESaIcEEE .text.hot._ZN14metablock_form4PackERKNSt7__cxx1112basic_stringIcSt11char_traitsIcESaIcEEE)
    *(.text._ZN14metablock_formL4FestEPSt6vectorIhSaIhEExi .text.unlikely._ZN14metablock_formL4FestEPSt6vectorIhSaIhEExi .text.hot._ZN14metablock_formL4FestEPSt6vectorIhSaIhEExi)
    *(.text._ZN7ip_pack4PackERKNSt7__cxx1112basic_stringIcSt11char_traitsIcESaIcEEE .text.unlikely._ZN7ip_pack4PackERKNSt7__cxx1112basic_stringIcSt11char_traitsIcESaIcEEE .text.hot._ZN7ip_pack4PackERKNSt7__cxx1112basic_stringIcSt11char_traitsIcESaIcEEE)
    *(.text._ZN7ip_pack7KodiereEPKhPh .text.unlikely._ZN7ip_pack7KodiereEPKhPh .text.hot._ZN7ip_pack7KodiereEPKhPh)
    *(.text._ZN7ip_pack6LiesIpEPKhmmPh .text.unlikely._ZN7ip_pack6LiesIpEPKhmmPh .text.hot._ZN7ip_pack6LiesIpEPKhmmPh)
    *(.text._ZN7ip_pack5WachtEbyy .text.unlikely._ZN7ip_pack5WachtEbyy .text.hot._ZN7ip_pack5WachtEbyy)
    
    *(.text._ZN10isbn_check4PackEv .text.unlikely._ZN10isbn_check4PackEv .text.hot._ZN10isbn_check4PackEv)
    *(.text._ZN10isbn_check5EndetEPKhm .text.unlikely._ZN10isbn_check5EndetEPKhm .text.hot._ZN10isbn_check5EndetEPKhm)
    
    
    *(.text._ZN3ord9ORDV3Vote6RecentEiPKi .text.unlikely._ZN3ord9ORDV3Vote6RecentEiPKi .text.hot._ZN3ord9ORDV3Vote6RecentEiPKi)
    *(.text._ZN3ord9ORDV3Vote3AddEil .text.unlikely._ZN3ord9ORDV3Vote3AddEil .text.hot._ZN3ord9ORDV3Vote3AddEil)
    *(.rodata._ZN3ordL7kKalTxtE)
    
    *(.rodata._ZN3ordL4kCenE)
    *(.rodata._ZN3ordL6kRedirE)
    *(.rodata._ZN3ord9Extractor5TitleEPKcS2_)
    
    *(.rodata.no_args)
    
    *(.rodata._ZZN3ordL6IlnQ57EmE8LN1P_Q62)
    
    *(.text._ZN12census_block10PseudoTextERKNSt7__cxx1112basic_stringIcSt11char_traitsIcESaIcEEEPS5_ .text.unlikely._ZN12census_block10PseudoTextERKNSt7__cxx1112basic_stringIcSt11char_traitsIcESaIcEEEPS5_ .text.hot._ZN12census_block10PseudoTextERKNSt7__cxx1112basic_stringIcSt11char_traitsIcESaIcEEEPS5_)
    *(.text._ZN12census_block3TypERKNS_5SeiteE .text.unlikely._ZN12census_block3TypERKNS_5SeiteE .text.hot._ZN12census_block3TypERKNS_5SeiteE)
    *(.text._ZN12census_block4B100EPNSt7__cxx1112basic_stringIcSt11char_traitsIcESaIcEEEmi .text.unlikely._ZN12census_block4B100EPNSt7__cxx1112basic_stringIcSt11char_traitsIcESaIcEEEmi .text.hot._ZN12census_block4B100EPNSt7__cxx1112basic_stringIcSt11char_traitsIcESaIcEEEmi)
    *(.text._ZN12census_block4FormD2Ev .text.unlikely._ZN12census_block4FormD2Ev .text.hot._ZN12census_block4FormD2Ev)
    *(.text._ZN12census_block5AbstrD2Ev .text.unlikely._ZN12census_block5AbstrD2Ev .text.hot._ZN12census_block5AbstrD2Ev)
    *(.text._ZN12census_block5AlnumEh .text.unlikely._ZN12census_block5AlnumEh .text.hot._ZN12census_block5AlnumEh)
    *(.text._ZN12census_block5NimmtEPKcl .text.unlikely._ZN12census_block5NimmtEPKcl .text.hot._ZN12census_block5NimmtEPKcl)
    *(.text._ZN12census_block7FamilieC2Ev .text.unlikely._ZN12census_block7FamilieC2Ev .text.hot._ZN12census_block7FamilieC2Ev)
    *(.text._ZN12census_block7FamilieD2Ev .text.unlikely._ZN12census_block7FamilieD2Ev .text.hot._ZN12census_block7FamilieD2Ev)
    *(.text._ZN12census_block8KodiererC2Ev .text.unlikely._ZN12census_block8KodiererC2Ev .text.hot._ZN12census_block8KodiererC2Ev)
    *(.text._ZN12census_block8KodiererD2Ev .text.unlikely._ZN12census_block8KodiererD2Ev .text.hot._ZN12census_block8KodiererD2Ev)
    *(.text._ZN12census_block8TitelTypEPKclPl .text.unlikely._ZN12census_block8TitelTypEPKclPl .text.hot._ZN12census_block8TitelTypEPKclPl)
    *(.text._ZN12census_block8VarianteC2Ev .text.unlikely._ZN12census_block8VarianteC2Ev .text.hot._ZN12census_block8VarianteC2Ev)
    *(.text._ZN12census_block8VarianteD2Ev .text.unlikely._ZN12census_block8VarianteD2Ev .text.hot._ZN12census_block8VarianteD2Ev)
    *(.text._ZN12census_block9WrtTauschEi .text.unlikely._ZN12census_block9WrtTauschEi .text.hot._ZN12census_block9WrtTauschEi)
    *(.text._ZN9__gnu_cxx5__ops15_Iter_comp_iterIZN12census_block10BaueFormenERNS2_8KodiererEEUlPKNS2_7FamilieES7_E_EclINS_17__normal_iteratorIPPS5_St6vectorISC_SaISC_EEEESH_EEbT_T0_ .text.unlikely._ZN9__gnu_cxx5__ops15_Iter_comp_iterIZN12census_block10BaueFormenERNS2_8KodiererEEUlPKNS2_7FamilieES7_E_EclINS_17__normal_iteratorIPPS5_St6vectorISC_SaISC_EEEESH_EEbT_T0_ .text.hot._ZN9__gnu_cxx5__ops15_Iter_comp_iterIZN12census_block10BaueFormenERNS2_8KodiererEEUlPKNS2_7FamilieES7_E_EclINS_17__normal_iteratorIPPS5_St6vectorISC_SaISC_EEEESH_EEbT_T0_)
    *(.text._ZN9__gnu_cxx5__ops15_Iter_comp_iterIZN12census_block10BaueFormenERNS2_8KodiererEEUlPKSt4pairIKNSt7__cxx1112basic_stringIcSt11char_traitsIcESaIcEEENS2_8VarianteEESG_E_EclINS_17__normal_iteratorIPPSE_St6vectorISL_SaISL_EEEESQ_EEbT_T0_ .text.unlikely._ZN9__gnu_cxx5__ops15_Iter_comp_iterIZN12census_block10BaueFormenERNS2_8KodiererEEUlPKSt4pairIKNSt7__cxx1112basic_stringIcSt11char_traitsIcESaIcEEENS2_8VarianteEESG_E_EclINS_17__normal_iteratorIPPSE_St6vectorISL_SaISL_EEEESQ_EEbT_T0_ .text.hot._ZN9__gnu_cxx5__ops15_Iter_comp_iterIZN12census_block10BaueFormenERNS2_8KodiererEEUlPKSt4pairIKNSt7__cxx1112basic_stringIcSt11char_traitsIcESaIcEEENS2_8VarianteEESG_E_EclINS_17__normal_iteratorIPPSE_St6vectorISL_SaISL_EEEESQ_EEbT_T0_)
    *(.text._ZNKSt14default_deleteIN12census_block8KodiererEEclEPS1_ .text.unlikely._ZNKSt14default_deleteIN12census_block8KodiererEEclEPS1_ .text.hot._ZNKSt14default_deleteIN12census_block8KodiererEEclEPS1_)
    *(.text._ZNSt10unique_ptrIN12census_block8KodiererESt14default_deleteIS1_EED2Ev .text.unlikely._ZNSt10unique_ptrIN12census_block8KodiererESt14default_deleteIS1_EED2Ev .text.hot._ZNSt10unique_ptrIN12census_block8KodiererESt14default_deleteIS1_EED2Ev)
    *(.text._ZNSt12_Destroy_auxILb0EE9__destroyIPN12census_block5AbstrEEEvT_S5_ .text.unlikely._ZNSt12_Destroy_auxILb0EE9__destroyIPN12census_block5AbstrEEEvT_S5_ .text.hot._ZNSt12_Destroy_auxILb0EE9__destroyIPN12census_block5AbstrEEEvT_S5_)
    *(.text._ZNSt27__uninitialized_default_n_1ILb0EE18__uninit_default_nIPN12census_block5AbstrEmEET_S5_T0_ .text.unlikely._ZNSt27__uninitialized_default_n_1ILb0EE18__uninit_default_nIPN12census_block5AbstrEmEET_S5_T0_ .text.hot._ZNSt27__uninitialized_default_n_1ILb0EE18__uninit_default_nIPN12census_block5AbstrEmEET_S5_T0_)
    *(.text._ZNSt6vectorIN12census_block5AbstrESaIS1_EE17_S_check_init_lenEmRKS2_ .text.unlikely._ZNSt6vectorIN12census_block5AbstrESaIS1_EE17_S_check_init_lenEmRKS2_ .text.hot._ZNSt6vectorIN12census_block5AbstrESaIS1_EE17_S_check_init_lenEmRKS2_)
    *(.text._ZNSt6vectorIN12census_block5AbstrESaIS1_EE21_M_default_initializeEm .text.unlikely._ZNSt6vectorIN12census_block5AbstrESaIS1_EE21_M_default_initializeEm .text.hot._ZNSt6vectorIN12census_block5AbstrESaIS1_EE21_M_default_initializeEm)
    *(.text._ZNSt6vectorIN12census_block5AbstrESaIS1_EEC2EmRKS2_ .text.unlikely._ZNSt6vectorIN12census_block5AbstrESaIS1_EEC2EmRKS2_ .text.hot._ZNSt6vectorIN12census_block5AbstrESaIS1_EEC2EmRKS2_)
    *(.text._ZNSt6vectorIN12census_block5AbstrESaIS1_EED2Ev .text.unlikely._ZNSt6vectorIN12census_block5AbstrESaIS1_EED2Ev .text.hot._ZNSt6vectorIN12census_block5AbstrESaIS1_EED2Ev)
    *(.text._ZNSt6vectorIPN12census_block7FamilieESaIS2_EE9push_backERKS2_ .text.unlikely._ZNSt6vectorIPN12census_block7FamilieESaIS2_EE9push_backERKS2_ .text.hot._ZNSt6vectorIPN12census_block7FamilieESaIS2_EE9push_backERKS2_)
    *(.text._ZNSt6vectorIPN12census_block8VarianteESaIS2_EEC2EmRKS2_RKS3_ .text.unlikely._ZNSt6vectorIPN12census_block8VarianteESaIS2_EEC2EmRKS2_RKS3_ .text.hot._ZNSt6vectorIPN12census_block8VarianteESaIS2_EEC2EmRKS2_RKS3_)
    *(.text._ZSt10__pop_heapIN9__gnu_cxx17__normal_iteratorIPPN12census_block7FamilieESt6vectorIS4_SaIS4_EEEENS0_5__ops15_Iter_comp_iterIZNS2_10BaueFormenERNS2_8KodiererEEUlPKS3_SF_E_EEEvT_SI_SI_RT0_ .text.unlikely._ZSt10__pop_heapIN9__gnu_cxx17__normal_iteratorIPPN12census_block7FamilieESt6vectorIS4_SaIS4_EEEENS0_5__ops15_Iter_comp_iterIZNS2_10BaueFormenERNS2_8KodiererEEUlPKS3_SF_E_EEEvT_SI_SI_RT0_ .text.hot._ZSt10__pop_heapIN9__gnu_cxx17__normal_iteratorIPPN12census_block7FamilieESt6vectorIS4_SaIS4_EEEENS0_5__ops15_Iter_comp_iterIZNS2_10BaueFormenERNS2_8KodiererEEUlPKS3_SF_E_EEEvT_SI_SI_RT0_)
    *(.text._ZSt10__pop_heapIN9__gnu_cxx17__normal_iteratorIPPSt4pairIKNSt7__cxx1112basic_stringIcSt11char_traitsIcESaIcEEEN12census_block8VarianteEESt6vectorISD_SaISD_EEEENS0_5__ops15_Iter_comp_iterIZNSA_10BaueFormenERNSA_8KodiererEEUlPKSC_SO_E_EEEvT_SR_SR_RT0_ .text.unlikely._ZSt10__pop_heapIN9__gnu_cxx17__normal_iteratorIPPSt4pairIKNSt7__cxx1112basic_stringIcSt11char_traitsIcESaIcEEEN12census_block8VarianteEESt6vectorISD_SaISD_EEEENS0_5__ops15_Iter_comp_iterIZNSA_10BaueFormenERNSA_8KodiererEEUlPKSC_SO_E_EEEvT_SR_SR_RT0_ .text.hot._ZSt10__pop_heapIN9__gnu_cxx17__normal_iteratorIPPSt4pairIKNSt7__cxx1112basic_stringIcSt11char_traitsIcESaIcEEEN12census_block8VarianteEESt6vectorISD_SaISD_EEEENS0_5__ops15_Iter_comp_iterIZNSA_10BaueFormenERNSA_8KodiererEEUlPKSC_SO_E_EEEvT_SR_SR_RT0_)
    *(.text._ZSt11__make_heapIN9__gnu_cxx17__normal_iteratorIPPN12census_block7FamilieESt6vectorIS4_SaIS4_EEEENS0_5__ops15_Iter_comp_iterIZNS2_10BaueFormenERNS2_8KodiererEEUlPKS3_SF_E_EEEvT_SI_RT0_ .text.unlikely._ZSt11__make_heapIN9__gnu_cxx17__normal_iteratorIPPN12census_block7FamilieESt6vectorIS4_SaIS4_EEEENS0_5__ops15_Iter_comp_iterIZNS2_10BaueFormenERNS2_8KodiererEEUlPKS3_SF_E_EEEvT_SI_RT0_ .text.hot._ZSt11__make_heapIN9__gnu_cxx17__normal_iteratorIPPN12census_block7FamilieESt6vectorIS4_SaIS4_EEEENS0_5__ops15_Iter_comp_iterIZNS2_10BaueFormenERNS2_8KodiererEEUlPKS3_SF_E_EEEvT_SI_RT0_)
    *(.text._ZSt11__make_heapIN9__gnu_cxx17__normal_iteratorIPPSt4pairIKNSt7__cxx1112basic_stringIcSt11char_traitsIcESaIcEEEN12census_block8VarianteEESt6vectorISD_SaISD_EEEENS0_5__ops15_Iter_comp_iterIZNSA_10BaueFormenERNSA_8KodiererEEUlPKSC_SO_E_EEEvT_SR_RT0_ .text.unlikely._ZSt11__make_heapIN9__gnu_cxx17__normal_iteratorIPPSt4pairIKNSt7__cxx1112basic_stringIcSt11char_traitsIcESaIcEEEN12census_block8VarianteEESt6vectorISD_SaISD_EEEENS0_5__ops15_Iter_comp_iterIZNSA_10BaueFormenERNSA_8KodiererEEUlPKSC_SO_E_EEEvT_SR_RT0_ .text.hot._ZSt11__make_heapIN9__gnu_cxx17__normal_iteratorIPPSt4pairIKNSt7__cxx1112basic_stringIcSt11char_traitsIcESaIcEEEN12census_block8VarianteEESt6vectorISD_SaISD_EEEENS0_5__ops15_Iter_comp_iterIZNSA_10BaueFormenERNSA_8KodiererEEUlPKSC_SO_E_EEEvT_SR_RT0_)
    *(.text._ZSt11__push_heapIN9__gnu_cxx17__normal_iteratorIPPN12census_block7FamilieESt6vectorIS4_SaIS4_EEEElS4_NS0_5__ops14_Iter_comp_valIZNS2_10BaueFormenERNS2_8KodiererEEUlPKS3_SF_E_EEEvT_T0_SJ_T1_RT2_ .text.unlikely._ZSt11__push_heapIN9__gnu_cxx17__normal_iteratorIPPN12census_block7FamilieESt6vectorIS4_SaIS4_EEEElS4_NS0_5__ops14_Iter_comp_valIZNS2_10BaueFormenERNS2_8KodiererEEUlPKS3_SF_E_EEEvT_T0_SJ_T1_RT2_ .text.hot._ZSt11__push_heapIN9__gnu_cxx17__normal_iteratorIPPN12census_block7FamilieESt6vectorIS4_SaIS4_EEEElS4_NS0_5__ops14_Iter_comp_valIZNS2_10BaueFormenERNS2_8KodiererEEUlPKS3_SF_E_EEEvT_T0_SJ_T1_RT2_)
    *(.text._ZSt11__push_heapIN9__gnu_cxx17__normal_iteratorIPPSt4pairIKNSt7__cxx1112basic_stringIcSt11char_traitsIcESaIcEEEN12census_block8VarianteEESt6vectorISD_SaISD_EEEElSD_NS0_5__ops14_Iter_comp_valIZNSA_10BaueFormenERNSA_8KodiererEEUlPKSC_SO_E_EEEvT_T0_SS_T1_RT2_ .text.unlikely._ZSt11__push_heapIN9__gnu_cxx17__normal_iteratorIPPSt4pairIKNSt7__cxx1112basic_stringIcSt11char_traitsIcESaIcEEEN12census_block8VarianteEESt6vectorISD_SaISD_EEEElSD_NS0_5__ops14_Iter_comp_valIZNSA_10BaueFormenERNSA_8KodiererEEUlPKSC_SO_E_EEEvT_T0_SS_T1_RT2_ .text.hot._ZSt11__push_heapIN9__gnu_cxx17__normal_iteratorIPPSt4pairIKNSt7__cxx1112basic_stringIcSt11char_traitsIcESaIcEEEN12census_block8VarianteEESt6vectorISD_SaISD_EEEElSD_NS0_5__ops14_Iter_comp_valIZNSA_10BaueFormenERNSA_8KodiererEEUlPKSC_SO_E_EEEvT_T0_SS_T1_RT2_)
    *(.text._ZSt11__sort_heapIN9__gnu_cxx17__normal_iteratorIPPN12census_block7FamilieESt6vectorIS4_SaIS4_EEEENS0_5__ops15_Iter_comp_iterIZNS2_10BaueFormenERNS2_8KodiererEEUlPKS3_SF_E_EEEvT_SI_RT0_ .text.unlikely._ZSt11__sort_heapIN9__gnu_cxx17__normal_iteratorIPPN12census_block7FamilieESt6vectorIS4_SaIS4_EEEENS0_5__ops15_Iter_comp_iterIZNS2_10BaueFormenERNS2_8KodiererEEUlPKS3_SF_E_EEEvT_SI_RT0_ .text.hot._ZSt11__sort_heapIN9__gnu_cxx17__normal_iteratorIPPN12census_block7FamilieESt6vectorIS4_SaIS4_EEEENS0_5__ops15_Iter_comp_iterIZNS2_10BaueFormenERNS2_8KodiererEEUlPKS3_SF_E_EEEvT_SI_RT0_)
    *(.text._ZSt11__sort_heapIN9__gnu_cxx17__normal_iteratorIPPSt4pairIKNSt7__cxx1112basic_stringIcSt11char_traitsIcESaIcEEEN12census_block8VarianteEESt6vectorISD_SaISD_EEEENS0_5__ops15_Iter_comp_iterIZNSA_10BaueFormenERNSA_8KodiererEEUlPKSC_SO_E_EEEvT_SR_RT0_ .text.unlikely._ZSt11__sort_heapIN9__gnu_cxx17__normal_iteratorIPPSt4pairIKNSt7__cxx1112basic_stringIcSt11char_traitsIcESaIcEEEN12census_block8VarianteEESt6vectorISD_SaISD_EEEENS0_5__ops15_Iter_comp_iterIZNSA_10BaueFormenERNSA_8KodiererEEUlPKSC_SO_E_EEEvT_SR_RT0_ .text.hot._ZSt11__sort_heapIN9__gnu_cxx17__normal_iteratorIPPSt4pairIKNSt7__cxx1112basic_stringIcSt11char_traitsIcESaIcEEEN12census_block8VarianteEESt6vectorISD_SaISD_EEEENS0_5__ops15_Iter_comp_iterIZNSA_10BaueFormenERNSA_8KodiererEEUlPKSC_SO_E_EEEvT_SR_RT0_)
    *(.text._ZSt13__adjust_heapIN9__gnu_cxx17__normal_iteratorIPPN12census_block7FamilieESt6vectorIS4_SaIS4_EEEElS4_NS0_5__ops15_Iter_comp_iterIZNS2_10BaueFormenERNS2_8KodiererEEUlPKS3_SF_E_EEEvT_T0_SJ_T1_T2_ .text.unlikely._ZSt13__adjust_heapIN9__gnu_cxx17__normal_iteratorIPPN12census_block7FamilieESt6vectorIS4_SaIS4_EEEElS4_NS0_5__ops15_Iter_comp_iterIZNS2_10BaueFormenERNS2_8KodiererEEUlPKS3_SF_E_EEEvT_T0_SJ_T1_T2_ .text.hot._ZSt13__adjust_heapIN9__gnu_cxx17__normal_iteratorIPPN12census_block7FamilieESt6vectorIS4_SaIS4_EEEElS4_NS0_5__ops15_Iter_comp_iterIZNS2_10BaueFormenERNS2_8KodiererEEUlPKS3_SF_E_EEEvT_T0_SJ_T1_T2_)
    *(.text._ZSt13__adjust_heapIN9__gnu_cxx17__normal_iteratorIPPSt4pairIKNSt7__cxx1112basic_stringIcSt11char_traitsIcESaIcEEEN12census_block8VarianteEESt6vectorISD_SaISD_EEEElSD_NS0_5__ops15_Iter_comp_iterIZNSA_10BaueFormenERNSA_8KodiererEEUlPKSC_SO_E_EEEvT_T0_SS_T1_T2_ .text.unlikely._ZSt13__adjust_heapIN9__gnu_cxx17__normal_iteratorIPPSt4pairIKNSt7__cxx1112basic_stringIcSt11char_traitsIcESaIcEEEN12census_block8VarianteEESt6vectorISD_SaISD_EEEElSD_NS0_5__ops15_Iter_comp_iterIZNSA_10BaueFormenERNSA_8KodiererEEUlPKSC_SO_E_EEEvT_T0_SS_T1_T2_ .text.hot._ZSt13__adjust_heapIN9__gnu_cxx17__normal_iteratorIPPSt4pairIKNSt7__cxx1112basic_stringIcSt11char_traitsIcESaIcEEEN12census_block8VarianteEESt6vectorISD_SaISD_EEEElSD_NS0_5__ops15_Iter_comp_iterIZNSA_10BaueFormenERNSA_8KodiererEEUlPKSC_SO_E_EEEvT_T0_SS_T1_T2_)
    *(.text._ZSt13__heap_selectIN9__gnu_cxx17__normal_iteratorIPPN12census_block7FamilieESt6vectorIS4_SaIS4_EEEENS0_5__ops15_Iter_comp_iterIZNS2_10BaueFormenERNS2_8KodiererEEUlPKS3_SF_E_EEEvT_SI_SI_T0_ .text.unlikely._ZSt13__heap_selectIN9__gnu_cxx17__normal_iteratorIPPN12census_block7FamilieESt6vectorIS4_SaIS4_EEEENS0_5__ops15_Iter_comp_iterIZNS2_10BaueFormenERNS2_8KodiererEEUlPKS3_SF_E_EEEvT_SI_SI_T0_ .text.hot._ZSt13__heap_selectIN9__gnu_cxx17__normal_iteratorIPPN12census_block7FamilieESt6vectorIS4_SaIS4_EEEENS0_5__ops15_Iter_comp_iterIZNS2_10BaueFormenERNS2_8KodiererEEUlPKS3_SF_E_EEEvT_SI_SI_T0_)
    *(.text._ZSt13__heap_selectIN9__gnu_cxx17__normal_iteratorIPPSt4pairIKNSt7__cxx1112basic_stringIcSt11char_traitsIcESaIcEEEN12census_block8VarianteEESt6vectorISD_SaISD_EEEENS0_5__ops15_Iter_comp_iterIZNSA_10BaueFormenERNSA_8KodiererEEUlPKSC_SO_E_EEEvT_SR_SR_T0_ .text.unlikely._ZSt13__heap_selectIN9__gnu_cxx17__normal_iteratorIPPSt4pairIKNSt7__cxx1112basic_stringIcSt11char_traitsIcESaIcEEEN12census_block8VarianteEESt6vectorISD_SaISD_EEEENS0_5__ops15_Iter_comp_iterIZNSA_10BaueFormenERNSA_8KodiererEEUlPKSC_SO_E_EEEvT_SR_SR_T0_ .text.hot._ZSt13__heap_selectIN9__gnu_cxx17__normal_iteratorIPPSt4pairIKNSt7__cxx1112basic_stringIcSt11char_traitsIcESaIcEEEN12census_block8VarianteEESt6vectorISD_SaISD_EEEENS0_5__ops15_Iter_comp_iterIZNSA_10BaueFormenERNSA_8KodiererEEUlPKSC_SO_E_EEEvT_SR_SR_T0_)
    *(.text._ZSt14__partial_sortIN9__gnu_cxx17__normal_iteratorIPPN12census_block7FamilieESt6vectorIS4_SaIS4_EEEENS0_5__ops15_Iter_comp_iterIZNS2_10BaueFormenERNS2_8KodiererEEUlPKS3_SF_E_EEEvT_SI_SI_T0_ .text.unlikely._ZSt14__partial_sortIN9__gnu_cxx17__normal_iteratorIPPN12census_block7FamilieESt6vectorIS4_SaIS4_EEEENS0_5__ops15_Iter_comp_iterIZNS2_10BaueFormenERNS2_8KodiererEEUlPKS3_SF_E_EEEvT_SI_SI_T0_ .text.hot._ZSt14__partial_sortIN9__gnu_cxx17__normal_iteratorIPPN12census_block7FamilieESt6vectorIS4_SaIS4_EEEENS0_5__ops15_Iter_comp_iterIZNS2_10BaueFormenERNS2_8KodiererEEUlPKS3_SF_E_EEEvT_SI_SI_T0_)
    *(.text._ZSt14__partial_sortIN9__gnu_cxx17__normal_iteratorIPPSt4pairIKNSt7__cxx1112basic_stringIcSt11char_traitsIcESaIcEEEN12census_block8VarianteEESt6vectorISD_SaISD_EEEENS0_5__ops15_Iter_comp_iterIZNSA_10BaueFormenERNSA_8KodiererEEUlPKSC_SO_E_EEEvT_SR_SR_T0_ .text.unlikely._ZSt14__partial_sortIN9__gnu_cxx17__normal_iteratorIPPSt4pairIKNSt7__cxx1112basic_stringIcSt11char_traitsIcESaIcEEEN12census_block8VarianteEESt6vectorISD_SaISD_EEEENS0_5__ops15_Iter_comp_iterIZNSA_10BaueFormenERNSA_8KodiererEEUlPKSC_SO_E_EEEvT_SR_SR_T0_ .text.hot._ZSt14__partial_sortIN9__gnu_cxx17__normal_iteratorIPPSt4pairIKNSt7__cxx1112basic_stringIcSt11char_traitsIcESaIcEEEN12census_block8VarianteEESt6vectorISD_SaISD_EEEENS0_5__ops15_Iter_comp_iterIZNSA_10BaueFormenERNSA_8KodiererEEUlPKSC_SO_E_EEEvT_SR_SR_T0_)
    *(.text._ZSt16__insertion_sortIN9__gnu_cxx17__normal_iteratorIPPN12census_block7FamilieESt6vectorIS4_SaIS4_EEEENS0_5__ops15_Iter_comp_iterIZNS2_10BaueFormenERNS2_8KodiererEEUlPKS3_SF_E_EEEvT_SI_T0_ .text.unlikely._ZSt16__insertion_sortIN9__gnu_cxx17__normal_iteratorIPPN12census_block7FamilieESt6vectorIS4_SaIS4_EEEENS0_5__ops15_Iter_comp_iterIZNS2_10BaueFormenERNS2_8KodiererEEUlPKS3_SF_E_EEEvT_SI_T0_ .text.hot._ZSt16__insertion_sortIN9__gnu_cxx17__normal_iteratorIPPN12census_block7FamilieESt6vectorIS4_SaIS4_EEEENS0_5__ops15_Iter_comp_iterIZNS2_10BaueFormenERNS2_8KodiererEEUlPKS3_SF_E_EEEvT_SI_T0_)
    *(.text._ZSt16__insertion_sortIN9__gnu_cxx17__normal_iteratorIPPSt4pairIKNSt7__cxx1112basic_stringIcSt11char_traitsIcESaIcEEEN12census_block8VarianteEESt6vectorISD_SaISD_EEEENS0_5__ops15_Iter_comp_iterIZNSA_10BaueFormenERNSA_8KodiererEEUlPKSC_SO_E_EEEvT_SR_T0_ .text.unlikely._ZSt16__insertion_sortIN9__gnu_cxx17__normal_iteratorIPPSt4pairIKNSt7__cxx1112basic_stringIcSt11char_traitsIcESaIcEEEN12census_block8VarianteEESt6vectorISD_SaISD_EEEENS0_5__ops15_Iter_comp_iterIZNSA_10BaueFormenERNSA_8KodiererEEUlPKSC_SO_E_EEEvT_SR_T0_ .text.hot._ZSt16__insertion_sortIN9__gnu_cxx17__normal_iteratorIPPSt4pairIKNSt7__cxx1112basic_stringIcSt11char_traitsIcESaIcEEEN12census_block8VarianteEESt6vectorISD_SaISD_EEEENS0_5__ops15_Iter_comp_iterIZNSA_10BaueFormenERNSA_8KodiererEEUlPKSC_SO_E_EEEvT_SR_T0_)
    *(.text._ZSt16__introsort_loopIN9__gnu_cxx17__normal_iteratorIPPN12census_block7FamilieESt6vectorIS4_SaIS4_EEEElNS0_5__ops15_Iter_comp_iterIZNS2_10BaueFormenERNS2_8KodiererEEUlPKS3_SF_E_EEEvT_SI_T0_T1_ .text.unlikely._ZSt16__introsort_loopIN9__gnu_cxx17__normal_iteratorIPPN12census_block7FamilieESt6vectorIS4_SaIS4_EEEElNS0_5__ops15_Iter_comp_iterIZNS2_10BaueFormenERNS2_8KodiererEEUlPKS3_SF_E_EEEvT_SI_T0_T1_ .text.hot._ZSt16__introsort_loopIN9__gnu_cxx17__normal_iteratorIPPN12census_block7FamilieESt6vectorIS4_SaIS4_EEEElNS0_5__ops15_Iter_comp_iterIZNS2_10BaueFormenERNS2_8KodiererEEUlPKS3_SF_E_EEEvT_SI_T0_T1_)
    *(.text._ZSt16__introsort_loopIN9__gnu_cxx17__normal_iteratorIPPSt4pairIKNSt7__cxx1112basic_stringIcSt11char_traitsIcESaIcEEEN12census_block8VarianteEESt6vectorISD_SaISD_EEEElNS0_5__ops15_Iter_comp_iterIZNSA_10BaueFormenERNSA_8KodiererEEUlPKSC_SO_E_EEEvT_SR_T0_T1_ .text.unlikely._ZSt16__introsort_loopIN9__gnu_cxx17__normal_iteratorIPPSt4pairIKNSt7__cxx1112basic_stringIcSt11char_traitsIcESaIcEEEN12census_block8VarianteEESt6vectorISD_SaISD_EEEElNS0_5__ops15_Iter_comp_iterIZNSA_10BaueFormenERNSA_8KodiererEEUlPKSC_SO_E_EEEvT_SR_T0_T1_ .text.hot._ZSt16__introsort_loopIN9__gnu_cxx17__normal_iteratorIPPSt4pairIKNSt7__cxx1112basic_stringIcSt11char_traitsIcESaIcEEEN12census_block8VarianteEESt6vectorISD_SaISD_EEEElNS0_5__ops15_Iter_comp_iterIZNSA_10BaueFormenERNSA_8KodiererEEUlPKSC_SO_E_EEEvT_SR_T0_T1_)
    *(.text._ZSt21__unguarded_partitionIN9__gnu_cxx17__normal_iteratorIPPN12census_block7FamilieESt6vectorIS4_SaIS4_EEEENS0_5__ops15_Iter_comp_iterIZNS2_10BaueFormenERNS2_8KodiererEEUlPKS3_SF_E_EEET_SI_SI_SI_T0_ .text.unlikely._ZSt21__unguarded_partitionIN9__gnu_cxx17__normal_iteratorIPPN12census_block7FamilieESt6vectorIS4_SaIS4_EEEENS0_5__ops15_Iter_comp_iterIZNS2_10BaueFormenERNS2_8KodiererEEUlPKS3_SF_E_EEET_SI_SI_SI_T0_ .text.hot._ZSt21__unguarded_partitionIN9__gnu_cxx17__normal_iteratorIPPN12census_block7FamilieESt6vectorIS4_SaIS4_EEEENS0_5__ops15_Iter_comp_iterIZNS2_10BaueFormenERNS2_8KodiererEEUlPKS3_SF_E_EEET_SI_SI_SI_T0_)
    *(.text._ZSt21__unguarded_partitionIN9__gnu_cxx17__normal_iteratorIPPSt4pairIKNSt7__cxx1112basic_stringIcSt11char_traitsIcESaIcEEEN12census_block8VarianteEESt6vectorISD_SaISD_EEEENS0_5__ops15_Iter_comp_iterIZNSA_10BaueFormenERNSA_8KodiererEEUlPKSC_SO_E_EEET_SR_SR_SR_T0_ .text.unlikely._ZSt21__unguarded_partitionIN9__gnu_cxx17__normal_iteratorIPPSt4pairIKNSt7__cxx1112basic_stringIcSt11char_traitsIcESaIcEEEN12census_block8VarianteEESt6vectorISD_SaISD_EEEENS0_5__ops15_Iter_comp_iterIZNSA_10BaueFormenERNSA_8KodiererEEUlPKSC_SO_E_EEET_SR_SR_SR_T0_ .text.hot._ZSt21__unguarded_partitionIN9__gnu_cxx17__normal_iteratorIPPSt4pairIKNSt7__cxx1112basic_stringIcSt11char_traitsIcESaIcEEEN12census_block8VarianteEESt6vectorISD_SaISD_EEEENS0_5__ops15_Iter_comp_iterIZNSA_10BaueFormenERNSA_8KodiererEEUlPKSC_SO_E_EEET_SR_SR_SR_T0_)
    *(.text._ZSt22__final_insertion_sortIN9__gnu_cxx17__normal_iteratorIPPN12census_block7FamilieESt6vectorIS4_SaIS4_EEEENS0_5__ops15_Iter_comp_iterIZNS2_10BaueFormenERNS2_8KodiererEEUlPKS3_SF_E_EEEvT_SI_T0_ .text.unlikely._ZSt22__final_insertion_sortIN9__gnu_cxx17__normal_iteratorIPPN12census_block7FamilieESt6vectorIS4_SaIS4_EEEENS0_5__ops15_Iter_comp_iterIZNS2_10BaueFormenERNS2_8KodiererEEUlPKS3_SF_E_EEEvT_SI_T0_ .text.hot._ZSt22__final_insertion_sortIN9__gnu_cxx17__normal_iteratorIPPN12census_block7FamilieESt6vectorIS4_SaIS4_EEEENS0_5__ops15_Iter_comp_iterIZNS2_10BaueFormenERNS2_8KodiererEEUlPKS3_SF_E_EEEvT_SI_T0_)
    *(.text._ZSt22__final_insertion_sortIN9__gnu_cxx17__normal_iteratorIPPSt4pairIKNSt7__cxx1112basic_stringIcSt11char_traitsIcESaIcEEEN12census_block8VarianteEESt6vectorISD_SaISD_EEEENS0_5__ops15_Iter_comp_iterIZNSA_10BaueFormenERNSA_8KodiererEEUlPKSC_SO_E_EEEvT_SR_T0_ .text.unlikely._ZSt22__final_insertion_sortIN9__gnu_cxx17__normal_iteratorIPPSt4pairIKNSt7__cxx1112basic_stringIcSt11char_traitsIcESaIcEEEN12census_block8VarianteEESt6vectorISD_SaISD_EEEENS0_5__ops15_Iter_comp_iterIZNSA_10BaueFormenERNSA_8KodiererEEUlPKSC_SO_E_EEEvT_SR_T0_ .text.hot._ZSt22__final_insertion_sortIN9__gnu_cxx17__normal_iteratorIPPSt4pairIKNSt7__cxx1112basic_stringIcSt11char_traitsIcESaIcEEEN12census_block8VarianteEESt6vectorISD_SaISD_EEEENS0_5__ops15_Iter_comp_iterIZNSA_10BaueFormenERNSA_8KodiererEEUlPKSC_SO_E_EEEvT_SR_T0_)
    *(.text._ZSt22__move_median_to_firstIN9__gnu_cxx17__normal_iteratorIPPN12census_block7FamilieESt6vectorIS4_SaIS4_EEEENS0_5__ops15_Iter_comp_iterIZNS2_10BaueFormenERNS2_8KodiererEEUlPKS3_SF_E_EEEvT_SI_SI_SI_T0_ .text.unlikely._ZSt22__move_median_to_firstIN9__gnu_cxx17__normal_iteratorIPPN12census_block7FamilieESt6vectorIS4_SaIS4_EEEENS0_5__ops15_Iter_comp_iterIZNS2_10BaueFormenERNS2_8KodiererEEUlPKS3_SF_E_EEEvT_SI_SI_SI_T0_ .text.hot._ZSt22__move_median_to_firstIN9__gnu_cxx17__normal_iteratorIPPN12census_block7FamilieESt6vectorIS4_SaIS4_EEEENS0_5__ops15_Iter_comp_iterIZNS2_10BaueFormenERNS2_8KodiererEEUlPKS3_SF_E_EEEvT_SI_SI_SI_T0_)
    *(.text._ZSt22__move_median_to_firstIN9__gnu_cxx17__normal_iteratorIPPSt4pairIKNSt7__cxx1112basic_stringIcSt11char_traitsIcESaIcEEEN12census_block8VarianteEESt6vectorISD_SaISD_EEEENS0_5__ops15_Iter_comp_iterIZNSA_10BaueFormenERNSA_8KodiererEEUlPKSC_SO_E_EEEvT_SR_SR_SR_T0_ .text.unlikely._ZSt22__move_median_to_firstIN9__gnu_cxx17__normal_iteratorIPPSt4pairIKNSt7__cxx1112basic_stringIcSt11char_traitsIcESaIcEEEN12census_block8VarianteEESt6vectorISD_SaISD_EEEENS0_5__ops15_Iter_comp_iterIZNSA_10BaueFormenERNSA_8KodiererEEUlPKSC_SO_E_EEEvT_SR_SR_SR_T0_ .text.hot._ZSt22__move_median_to_firstIN9__gnu_cxx17__normal_iteratorIPPSt4pairIKNSt7__cxx1112basic_stringIcSt11char_traitsIcESaIcEEEN12census_block8VarianteEESt6vectorISD_SaISD_EEEENS0_5__ops15_Iter_comp_iterIZNSA_10BaueFormenERNSA_8KodiererEEUlPKSC_SO_E_EEEvT_SR_SR_SR_T0_)
    *(.text._ZSt25__unguarded_linear_insertIN9__gnu_cxx17__normal_iteratorIPPN12census_block7FamilieESt6vectorIS4_SaIS4_EEEENS0_5__ops14_Val_comp_iterIZNS2_10BaueFormenERNS2_8KodiererEEUlPKS3_SF_E_EEEvT_T0_ .text.unlikely._ZSt25__unguarded_linear_insertIN9__gnu_cxx17__normal_iteratorIPPN12census_block7FamilieESt6vectorIS4_SaIS4_EEEENS0_5__ops14_Val_comp_iterIZNS2_10BaueFormenERNS2_8KodiererEEUlPKS3_SF_E_EEEvT_T0_ .text.hot._ZSt25__unguarded_linear_insertIN9__gnu_cxx17__normal_iteratorIPPN12census_block7FamilieESt6vectorIS4_SaIS4_EEEENS0_5__ops14_Val_comp_iterIZNS2_10BaueFormenERNS2_8KodiererEEUlPKS3_SF_E_EEEvT_T0_)
    *(.text._ZSt25__unguarded_linear_insertIN9__gnu_cxx17__normal_iteratorIPPSt4pairIKNSt7__cxx1112basic_stringIcSt11char_traitsIcESaIcEEEN12census_block8VarianteEESt6vectorISD_SaISD_EEEENS0_5__ops14_Val_comp_iterIZNSA_10BaueFormenERNSA_8KodiererEEUlPKSC_SO_E_EEEvT_T0_ .text.unlikely._ZSt25__unguarded_linear_insertIN9__gnu_cxx17__normal_iteratorIPPSt4pairIKNSt7__cxx1112basic_stringIcSt11char_traitsIcESaIcEEEN12census_block8VarianteEESt6vectorISD_SaISD_EEEENS0_5__ops14_Val_comp_iterIZNSA_10BaueFormenERNSA_8KodiererEEUlPKSC_SO_E_EEEvT_T0_ .text.hot._ZSt25__unguarded_linear_insertIN9__gnu_cxx17__normal_iteratorIPPSt4pairIKNSt7__cxx1112basic_stringIcSt11char_traitsIcESaIcEEEN12census_block8VarianteEESt6vectorISD_SaISD_EEEENS0_5__ops14_Val_comp_iterIZNSA_10BaueFormenERNSA_8KodiererEEUlPKSC_SO_E_EEEvT_T0_)
    *(.text._ZSt26__unguarded_insertion_sortIN9__gnu_cxx17__normal_iteratorIPPN12census_block7FamilieESt6vectorIS4_SaIS4_EEEENS0_5__ops15_Iter_comp_iterIZNS2_10BaueFormenERNS2_8KodiererEEUlPKS3_SF_E_EEEvT_SI_T0_ .text.unlikely._ZSt26__unguarded_insertion_sortIN9__gnu_cxx17__normal_iteratorIPPN12census_block7FamilieESt6vectorIS4_SaIS4_EEEENS0_5__ops15_Iter_comp_iterIZNS2_10BaueFormenERNS2_8KodiererEEUlPKS3_SF_E_EEEvT_SI_T0_ .text.hot._ZSt26__unguarded_insertion_sortIN9__gnu_cxx17__normal_iteratorIPPN12census_block7FamilieESt6vectorIS4_SaIS4_EEEENS0_5__ops15_Iter_comp_iterIZNS2_10BaueFormenERNS2_8KodiererEEUlPKS3_SF_E_EEEvT_SI_T0_)
    *(.text._ZSt26__unguarded_insertion_sortIN9__gnu_cxx17__normal_iteratorIPPSt4pairIKNSt7__cxx1112basic_stringIcSt11char_traitsIcESaIcEEEN12census_block8VarianteEESt6vectorISD_SaISD_EEEENS0_5__ops15_Iter_comp_iterIZNSA_10BaueFormenERNSA_8KodiererEEUlPKSC_SO_E_EEEvT_SR_T0_ .text.unlikely._ZSt26__unguarded_insertion_sortIN9__gnu_cxx17__normal_iteratorIPPSt4pairIKNSt7__cxx1112basic_stringIcSt11char_traitsIcESaIcEEEN12census_block8VarianteEESt6vectorISD_SaISD_EEEENS0_5__ops15_Iter_comp_iterIZNSA_10BaueFormenERNSA_8KodiererEEUlPKSC_SO_E_EEEvT_SR_T0_ .text.hot._ZSt26__unguarded_insertion_sortIN9__gnu_cxx17__normal_iteratorIPPSt4pairIKNSt7__cxx1112basic_stringIcSt11char_traitsIcESaIcEEEN12census_block8VarianteEESt6vectorISD_SaISD_EEEENS0_5__ops15_Iter_comp_iterIZNSA_10BaueFormenERNSA_8KodiererEEUlPKSC_SO_E_EEEvT_SR_T0_)
    *(.text._ZSt27__unguarded_partition_pivotIN9__gnu_cxx17__normal_iteratorIPPN12census_block7FamilieESt6vectorIS4_SaIS4_EEEENS0_5__ops15_Iter_comp_iterIZNS2_10BaueFormenERNS2_8KodiererEEUlPKS3_SF_E_EEET_SI_SI_T0_ .text.unlikely._ZSt27__unguarded_partition_pivotIN9__gnu_cxx17__normal_iteratorIPPN12census_block7FamilieESt6vectorIS4_SaIS4_EEEENS0_5__ops15_Iter_comp_iterIZNS2_10BaueFormenERNS2_8KodiererEEUlPKS3_SF_E_EEET_SI_SI_T0_ .text.hot._ZSt27__unguarded_partition_pivotIN9__gnu_cxx17__normal_iteratorIPPN12census_block7FamilieESt6vectorIS4_SaIS4_EEEENS0_5__ops15_Iter_comp_iterIZNS2_10BaueFormenERNS2_8KodiererEEUlPKS3_SF_E_EEET_SI_SI_T0_)
    *(.text._ZSt27__unguarded_partition_pivotIN9__gnu_cxx17__normal_iteratorIPPSt4pairIKNSt7__cxx1112basic_stringIcSt11char_traitsIcESaIcEEEN12census_block8VarianteEESt6vectorISD_SaISD_EEEENS0_5__ops15_Iter_comp_iterIZNSA_10BaueFormenERNSA_8KodiererEEUlPKSC_SO_E_EEET_SR_SR_T0_ .text.unlikely._ZSt27__unguarded_partition_pivotIN9__gnu_cxx17__normal_iteratorIPPSt4pairIKNSt7__cxx1112basic_stringIcSt11char_traitsIcESaIcEEEN12census_block8VarianteEESt6vectorISD_SaISD_EEEENS0_5__ops15_Iter_comp_iterIZNSA_10BaueFormenERNSA_8KodiererEEUlPKSC_SO_E_EEET_SR_SR_T0_ .text.hot._ZSt27__unguarded_partition_pivotIN9__gnu_cxx17__normal_iteratorIPPSt4pairIKNSt7__cxx1112basic_stringIcSt11char_traitsIcESaIcEEEN12census_block8VarianteEESt6vectorISD_SaISD_EEEENS0_5__ops15_Iter_comp_iterIZNSA_10BaueFormenERNSA_8KodiererEEUlPKSC_SO_E_EEET_SR_SR_T0_)
    *(.text._ZSt6__sortIN9__gnu_cxx17__normal_iteratorIPPN12census_block7FamilieESt6vectorIS4_SaIS4_EEEENS0_5__ops15_Iter_comp_iterIZNS2_10BaueFormenERNS2_8KodiererEEUlPKS3_SF_E_EEEvT_SI_T0_ .text.unlikely._ZSt6__sortIN9__gnu_cxx17__normal_iteratorIPPN12census_block7FamilieESt6vectorIS4_SaIS4_EEEENS0_5__ops15_Iter_comp_iterIZNS2_10BaueFormenERNS2_8KodiererEEUlPKS3_SF_E_EEEvT_SI_T0_ .text.hot._ZSt6__sortIN9__gnu_cxx17__normal_iteratorIPPN12census_block7FamilieESt6vectorIS4_SaIS4_EEEENS0_5__ops15_Iter_comp_iterIZNS2_10BaueFormenERNS2_8KodiererEEUlPKS3_SF_E_EEEvT_SI_T0_)
    *(.text._ZSt6__sortIN9__gnu_cxx17__normal_iteratorIPPSt4pairIKNSt7__cxx1112basic_stringIcSt11char_traitsIcESaIcEEEN12census_block8VarianteEESt6vectorISD_SaISD_EEEENS0_5__ops15_Iter_comp_iterIZNSA_10BaueFormenERNSA_8KodiererEEUlPKSC_SO_E_EEEvT_SR_T0_ .text.unlikely._ZSt6__sortIN9__gnu_cxx17__normal_iteratorIPPSt4pairIKNSt7__cxx1112basic_stringIcSt11char_traitsIcESaIcEEEN12census_block8VarianteEESt6vectorISD_SaISD_EEEENS0_5__ops15_Iter_comp_iterIZNSA_10BaueFormenERNSA_8KodiererEEUlPKSC_SO_E_EEEvT_SR_T0_ .text.hot._ZSt6__sortIN9__gnu_cxx17__normal_iteratorIPPSt4pairIKNSt7__cxx1112basic_stringIcSt11char_traitsIcESaIcEEEN12census_block8VarianteEESt6vectorISD_SaISD_EEEENS0_5__ops15_Iter_comp_iterIZNSA_10BaueFormenERNSA_8KodiererEEUlPKSC_SO_E_EEEvT_SR_T0_)
    *(.text._ZZN12census_block10BaueFormenERNS_8KodiererEENKUlPKNS_7FamilieES4_E_clES4_S4_ .text.unlikely._ZZN12census_block10BaueFormenERNS_8KodiererEENKUlPKNS_7FamilieES4_E_clES4_S4_ .text.hot._ZZN12census_block10BaueFormenERNS_8KodiererEENKUlPKNS_7FamilieES4_E_clES4_S4_)
    *(.text._ZZN12census_block10BaueFormenERNS_8KodiererEENKUlPKSt4pairIKNSt7__cxx1112basic_stringIcSt11char_traitsIcESaIcEEENS_8VarianteEESD_E_clESD_SD_ .text.unlikely._ZZN12census_block10BaueFormenERNS_8KodiererEENKUlPKSt4pairIKNSt7__cxx1112basic_stringIcSt11char_traitsIcESaIcEEENS_8VarianteEESD_E_clESD_SD_ .text.hot._ZZN12census_block10BaueFormenERNS_8KodiererEENKUlPKSt4pairIKNSt7__cxx1112basic_stringIcSt11char_traitsIcESaIcEEENS_8VarianteEESD_E_clESD_SD_)
    *(.text._ZZN12census_block9EtikettenERKNSt7__cxx1112basic_stringIcSt11char_traitsIcESaIcEEEPSt6vectorIhSaIhEEENKUlPKcE_clESD_ .text.unlikely._ZZN12census_block9EtikettenERKNSt7__cxx1112basic_stringIcSt11char_traitsIcESaIcEEEPSt6vectorIhSaIhEEENKUlPKcE_clESD_ .text.hot._ZZN12census_block9EtikettenERKNSt7__cxx1112basic_stringIcSt11char_traitsIcESaIcEEEPSt6vectorIhSaIhEEENKUlPKcE_clESD_)
    *(.text._ZZN12census_block9EtikettenERKNSt7__cxx1112basic_stringIcSt11char_traitsIcESaIcEEEPSt6vectorIhSaIhEEENKUlSt16initializer_listIiEE_clESD_ .text.unlikely._ZZN12census_block9EtikettenERKNSt7__cxx1112basic_stringIcSt11char_traitsIcESaIcEEEPSt6vectorIhSaIhEEENKUlSt16initializer_listIiEE_clESD_ .text.hot._ZZN12census_block9EtikettenERKNSt7__cxx1112basic_stringIcSt11char_traitsIcESaIcEEEPSt6vectorIhSaIhEEENKUlSt16initializer_listIiEE_clESD_)
    
    *(.rodata._ZN12census_block10PseudoTextERKNSt7__cxx1112basic_stringIcSt11char_traitsIcESaIcEEEPS5_)
    *(.rodata._ZN12census_block9EtikettenERKNSt7__cxx1112basic_stringIcSt11char_traitsIcESaIcEEEPSt6vectorIhSaIhEE)
    *(.rodata._ZZN12census_block11AutomatischERKNSt7__cxx1112basic_stringIcSt11char_traitsIcESaIcEEEE4head)
    *(.rodata._ZZN12census_block7SkelettERKNSt7__cxx1112basic_stringIcSt11char_traitsIcESaIcEEEE3ers)
    *(.rodata._ZZN12census_block9EtikettenERKNSt7__cxx1112basic_stringIcSt11char_traitsIcESaIcEEEPSt6vectorIhSaIhEEE3fs4)
    *(.rodata._ZZN12census_block9EtikettenERKNSt7__cxx1112basic_stringIcSt11char_traitsIcESaIcEEEPSt6vectorIhSaIhEEE3fs8)
    *(.rodata._ZZN12census_block3TypERKNS_5SeiteEE1w)
    
    *(.text._ZL11cen_try_subllPKci .text.unlikely._ZL11cen_try_subllPKci .text.hot._ZL11cen_try_subllPKci)
    *(.text._ZL10cen_eq_pm1PKclld .text.unlikely._ZL10cen_eq_pm1PKclld .text.hot._ZL10cen_eq_pm1PKclld)
    *(.text._ZL13cen_wdens_subPKcllddd .text.unlikely._ZL13cen_wdens_subPKcllddd .text.hot._ZL13cen_wdens_subPKcllddd)
    *(.text._ZL12cen_dens_subPKclld .text.unlikely._ZL12cen_dens_subPKclld .text.hot._ZL12cen_dens_subPKclld)
    *(.text._ZL15cen_dens_ladderPKclld .text.unlikely._ZL15cen_dens_ladderPKclld .text.hot._ZL15cen_dens_ladderPKclld)
    *(.text._ZN12census_block8TypIndexEc .text.unlikely._ZN12census_block8TypIndexEc .text.hot._ZN12census_block8TypIndexEc)
    
    
    *(.text._ZL13hsort_is_headPKci .text.unlikely._ZL13hsort_is_headPKci .text.hot._ZL13hsort_is_headPKci)
    *(.text._ZN8run_mode4Gram9ViolationEyjii .text.unlikely._ZN8run_mode4Gram9ViolationEyjii .text.hot._ZN8run_mode4Gram9ViolationEyjii)
    *(.text._ZN10text_start5NamenC2EPKh .text.unlikely._ZN10text_start5NamenC2EPKh .text.hot._ZN10text_start5NamenC2EPKh)
    *(.text._ZL7g1_putsPmPKc .text.unlikely._ZL7g1_putsPmPKc .text.hot._ZL7g1_putsPmPKc)
    *(.text._ZL17redirect_word_endPKcm .text.unlikely._ZL17redirect_word_endPKcm .text.hot._ZL17redirect_word_endPKcm)
    
    *(.text._ZNSt6vectorIPN12census_block7FamilieESaIS2_EEC2ERKS4_ .text.unlikely._ZNSt6vectorIPN12census_block7FamilieESaIS2_EEC2ERKS4_ .text.hot._ZNSt6vectorIPN12census_block7FamilieESaIS2_EEC2ERKS4_)
    *(.text.enc_only)
    
    *(.rodata.enc_only)
  }
} INSERT AFTER .got.plt;
